## Buildroot/package/python-protobuf/Config.in
```kconfig
config BR2_PACKAGE_PYTHON_PROTOBUF
	bool "python-protobuf"
	help
	  Protocol Buffers.

	  https://developers.google.com/protocol-buffers/
```

## Buildroot/package/python-pyrebase/Config.in
```kconfig
config BR2_PACKAGE_PYTHON_PYREBASE
	bool "python-pyrebase"
	#select BR2_PACKAGE_PYTHON_GCLOUD # runtime
	select BR2_PACKAGE_PYTHON_JWT # runtime
	select BR2_PACKAGE_PYTHON_OAUTH2CLIENT # runtime
	select BR2_PACKAGE_PYTHON_PYCRYPTODOME # runtime
	select BR2_PACKAGE_PYTHON_REQUESTS # runtime
	select BR2_PACKAGE_PYTHON_REQUESTS_TOOLBELT # runtime
	help
	  A simple python wrapper for the Firebase API.

	  https://github.com/thisbejim/Pyrebase
```

## Buildroot/package/python-pyrebase4/Config.in
```kconfig
config BR2_PACKAGE_PYTHON_PYREBASE4
	bool "python-pyrebase4"
	select BR2_PACKAGE_PYTHON_GCLOUD # runtime
	select BR2_PACKAGE_PYTHON_JWT # runtime
	select BR2_PACKAGE_PYTHON_OAUTH2CLIENT # runtime
	select BR2_PACKAGE_PYTHON_PYCRYPTODOME # runtime
	select BR2_PACKAGE_PYTHON_REQUESTS # runtime
	select BR2_PACKAGE_PYTHON_REQUESTS_TOOLBELT # runtime
	help
	  A simple python wrapper for the Firebase API with current
	  deps.

	  https://github.com/nhorvath/Pyrebase4
```

## Buildroot/package/python-six/Config.in
```kconfig
config BR2_PACKAGE_PYTHON_SIX
	bool "python-six"
	help
	  Python 2 and 3 compatibility utilities.

	  https://github.com/benjaminp/six
```

## Buildroot/package/python-urllib3/Config.in
```kconfig
config BR2_PACKAGE_PYTHON_URLLIB3
	bool "python-urllib3"
	help
	  HTTP library with thread-safe connection pooling, file
	  post, and more.

	  https://urllib3.readthedocs.io/
```

## buildroot-2021.02.5_project/package/python-asyncio/Config.in
```kconfig
config BR2_PACKAGE_PYTHON_ASYNCIO
	bool "python-asyncio"
	help
	  reference implementation of PEP 3156.

	  http://www.python.org/dev/peps/pep-3156/
```

## buildroot-2021.02.5_project/package/python-httplib2/Config.in
```kconfig
config BR2_PACKAGE_PYTHON_HTTPLIB2
	bool "python-httplib2"
	select BR2_PACKAGE_PYTHON_PYPARSING # runtime
	select BR2_PACKAGE_PYTHON_PYPARSING # runtime
	help
	  A comprehensive HTTP client library.

	  https://github.com/httplib2/httplib2
```

## buildroot-2021.02.5_project/package/python-pyparsing/Config.in
```kconfig
config BR2_PACKAGE_PYTHON_PYPARSING
	bool "python-pyparsing"
	help
	  Python parsing module.

	  https://github.com/pyparsing/pyparsing/
```

## buildroot-2021.02.5_project/package/python-rsa/Config.in
```kconfig
config BR2_PACKAGE_PYTHON_RSA
	bool "python-rsa"
	select BR2_PACKAGE_PYTHON_PYASN1 # runtime
	help
	  Pure-Python RSA implementation.

	  https://stuvel.eu/rsa
```
